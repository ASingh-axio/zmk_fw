## app/boards/arm/axio/Kconfig.defconfig
```kconfig
# nRF52840-MDK board configuration

# Copyright (c) 2018 makerdiary.com
# SPDX-License-Identifier: Apache-2.0

#if BOARD_NRF52840_MDK

if BOARD_AXIO

#config BOARD
#	default "axio"

config BOARD
	default "axio"
config BT_CTLR
	default BT

endif

#endif # BOARD_NRF52840_MDK
```

## app/boards/arm/axio/axio_defconfig
```kconfig
# SPDX-License-Identifier: Apache-2.0

CONFIG_SOC_SERIES_NRF52X=y
CONFIG_SOC_NRF52840_QIAA=y
CONFIG_BOARD_AXIO=y


# Enable MPU
CONFIG_ARM_MPU=y

# enable GPIO

CONFIG_GPIO=y
CONFIG_ZMK_USB=y
CONFIG_ZMK_BLE=y

# enable uart driver
CONFIG_SERIAL=y

# enable console
CONFIG_CONSOLE=y
CONFIG_UART_CONSOLE=y
CONFIG_BUILD_OUTPUT_UF2=y
CONFIG_ZMK_USB_LOGGING=y
CONFIG_LOG=y
CONFIG_LOG_PROCESS_THREAD_STARTUP_DELAY_MS=8000
CONFIG_ZMK_LOG_LEVEL_DBG=y
CONFIG_LOG_BUFFER_SIZE=20000



CONFIG_USB_DEVICE_STACK=y
CONFIG_USB_DEVICE_PRODUCT="ZMK Keyboard"
#CONFIG_USB_UART_CONSOLE=y
```

## app/boards/arm/axio_split/Kconfig.board
```kconfig
# nRF52840-MDK board configuration

# Copyright (c) 2018 makerdiary.com
# SPDX-License-Identifier: Apache-2.0

config BOARD_AXIO_SPLIT_LH
    bool "AXIO_SPLIT LH"
    depends on SOC_NRF52840_QIAA

config BOARD_AXIO_SPLIT_RH
    bool "AXIO_SPLIT RH"
    depends on SOC_NRF52840_QIAA
```

## app/boards/arm/axio_split/Kconfig.defconfig
```kconfig
# Copyright (c) 2018 makerdiary.com
# SPDX-License-Identifier: Apache-2.0

if BOARD_AXIO_SPLIT_LH

config BOARD
    default "axio_split"

config ZMK_SPLIT_ROLE_CENTRAL
    default y

endif # BOARD_AXIO_SPLIT_LH

#if BOARD_AXIO_SPLIT_RH

#config BOARD
#    default "axio_split rh"

#endif # BOARD_AXIO_SPLIT_RH

if BOARD_AXIO_SPLIT_LH || BOARD_AXIO_SPLIT_RH

config ZMK_SPLIT
    default y

config BT_CTLR
    default BT


config PINCTRL
    default y

if USB

config USB_NRFX
    default y

config USB_DEVICE_STACK
    default y

endif # USB



endif # BOARD_AXIO_SPLIT_LH || BOARD_AXIO_SPLIT_RH
```

## app/boards/arm/leap/Kconfig.defconfig
```kconfig
# Copyright (c) 2018 makerdiary.com
# SPDX-License-Identifier: Apache-2.0

if BOARD_LEAP

config ZMK_KEYBOARD_NAME
    default "leap"

if USB_DEVICE_STACK

config USB_NRFX
    default y

endif # USB_DEVICE_STACK

config BT_CTLR
	default BT

endif #BOARD_LEAP
```

## app/boards/shields/oixa/Kconfig.defconfig
```kconfig
if SHIELD_OIXA_LEFT

config ZMK_KEYBOARD_NAME
    default "axio!"

config ZMK_SPLIT_ROLE_CENTRAL
    default y

endif

if SHIELD_OIXA_LEFT || SHIELD_OIXA_RIGHT

config ZMK_SPLIT
    default y

endif
```

## app/boards/shields/oixa/Kconfig.shield
```kconfig
# Copyright (c) 2020 Pete Johanson
# SPDX-License-Identifier: MIT

config SHIELD_OIXA_LEFT
    #def_bool $(shields_list_contains,oixa_left)
    def_bool Y

config SHIELD_OIXA_RIGHT
    #def_bool $(shields_list_contains,oixa_right)
    def_bool Y
```
