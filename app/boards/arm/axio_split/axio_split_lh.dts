/*
 * Copyright (c) 2017 Linaro Limited
 *
 * SPDX-License-Identifier: Apache-2.0
 */


#include "axio_split.dtsi"


/ {
	model = "axio_split_lh";
	compatible = "axio_split_lh";
    chosen {
                zmk,battery = &vbatt;

    };

    vbatt: vbatt {
        compatible = "zmk,battery-voltage-divider";
        io-channels = <&adc 0>;
        output-ohms = <470000>;
        full-ohms = <(470000 + 470000)>;
    };
/*
        kscan0: kscan {
        compatible = "zmk,kscan-gpio-direct";
        wakeup-source;
        input-gpios
            = <&gpio0 9 (GPIO_ACTIVE_LOW | GPIO_PULL_UP)>
            , <&gpio0 10  (GPIO_ACTIVE_LOW | GPIO_PULL_UP)>
            , <&gpio0 29  (GPIO_ACTIVE_LOW | GPIO_PULL_UP)>
            , <&gpio0 31 (GPIO_ACTIVE_LOW | GPIO_PULL_UP)>
            , <&gpio0 11  (GPIO_ACTIVE_LOW | GPIO_PULL_UP)>
            , <&gpio0 17  (GPIO_ACTIVE_LOW | GPIO_PULL_UP)>
            , <&gpio0 20  (GPIO_ACTIVE_LOW | GPIO_PULL_UP)>
            , <&gpio0 22  (GPIO_ACTIVE_LOW | GPIO_PULL_UP)>
            , <&gpio0 6  (GPIO_ACTIVE_LOW | GPIO_PULL_UP)>
            , <&gpio0 24  (GPIO_ACTIVE_LOW | GPIO_PULL_UP)>
            , <&gpio1 15 (GPIO_ACTIVE_LOW | GPIO_PULL_UP)>
            , <&gpio1 13  (GPIO_ACTIVE_LOW | GPIO_PULL_UP)>
            , <&gpio1 11  (GPIO_ACTIVE_LOW | GPIO_PULL_UP)>
            , <&gpio1 4  (GPIO_ACTIVE_LOW | GPIO_PULL_UP)>
            , <&gpio1 6  (GPIO_ACTIVE_LOW | GPIO_PULL_UP)>
            , <&gpio1 0  (GPIO_ACTIVE_LOW | GPIO_PULL_UP)>
            ;
            
    };*/
};

